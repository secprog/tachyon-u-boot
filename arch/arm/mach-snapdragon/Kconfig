## drivers/soc/qcom/Kconfig
```kconfig
# SPDX-License-Identifier: GPL-2.0-only
#
# QCOM Soc drivers
#
menuconfig SOC_QCOM
	bool "Qualcomm SOC drivers support"
	help
	  Say Y here if you want to enable Qualcomm SOC drivers support.

if SOC_QCOM

config QCOM_COMMAND_DB
	bool "Qualcomm Command DB"
	help
	  Command DB queries shared memory by key string for shared system
	  resources. Platform drivers that require to set state of a shared
	  resource on a RPM-hardened platform must use this database to get
	  SoC specific identifier and information for the shared resources.

config QCOM_RPMH
	bool "Qualcomm RPMh support"
	depends on QCOM_COMMAND_DB
	help
	  Say y here to support the Qualcomm RPMh (resource peripheral manager)
	  if you need to control regulators on Qualcomm platforms, say y here.

config QCOM_ADSP_PAS
	bool "Qualcomm ADSP PAS bootstrap"
	depends on ARM64 && OF_CONTROL && BLK && ARCH_SNAPDRAGON
	select ARM_SMCCC
	select CLK
	select CLK_STUB
	select EFI_PARTITION
	select FS_FAT
	select POWER_DOMAIN
	select QCOM_RPMH_POWER_DOMAIN
	help
	  Start Qualcomm ADSP/LPASS through the Peripheral Authentication
	  Service using firmware stored in the modem_a FAT partition.

config QCOM_AOSS_QMP
	bool "Qualcomm AOSS QMP driver"
	depends on DM_MAILBOX && QCOM_IPCC && ARCH_SNAPDRAGON
	help
	  Enable support for the Qualcomm AOSS QMP (Qualcomm Messaging
	  Protocol) driver. This communicates with the Always-On Processor
	  (AOP) via shared memory (MSGRAM) and IPCC doorbell to toggle
	  remote processor load states and other AOP-managed resources.

config QCOM_PMIC_GLINK
	bool "Qualcomm PMIC GLINK transport"
	depends on MSM_SMEM && ARM64 && OF_CONTROL && BLK
	select QCOM_ADSP_PAS
	select DM_MAILBOX
	select QCOM_IPCC
	help
	  Enable a small Qualcomm PMIC-GLINK transport over the LPASS/ADSP
	  GLINK-SMEM edge. This is used during early boot to query USB-C
	  DisplayPort Alt Mode policy before initializing the display path.

config QCOM_PMIC_GLINK_ALTMODE
	bool "Type-C/DisplayPort alt-mode client for PMIC GLINK"
	depends on QCOM_PMIC_GLINK
	select QCOM_PMIC_GLINK_UCSI
	default y
	help
	  Bind the PMIC-GLINK altmode child device that parses USB-C alt-mode
	  notifications and drives the DisplayPort entry path. Provides the
	  qcom_pmic_glink_altmode_*() API consumed by the Tachyon DP driver.
	  Required for USB-C DisplayPort output.

config QCOM_PMIC_GLINK_UCSI
	bool "UCSI client for PMIC GLINK"
	depends on QCOM_PMIC_GLINK
	default y
	help
	  Bind the PMIC-GLINK UCSI child device used for connector status and
	  the data-role swap (SET_UOR) needed to enter DisplayPort alt mode.

config QCOM_PMIC_GLINK_BATTMGR
	bool "Battery manager client for PMIC GLINK"
	depends on QCOM_PMIC_GLINK
	default n
	help
	  Bind the optional PMIC-GLINK battery-manager child device. Not needed
	  for the USB-C/DisplayPort path; enable only if battery telemetry over
	  PMIC-GLINK is required.

endif # SOC_QCOM
```
